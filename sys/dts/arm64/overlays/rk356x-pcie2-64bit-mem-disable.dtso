/dts-v1/;
/plugin/;

/{
    compatible = "rockchip,rk3568";
};

&{/pcie@fe260000} {
    ranges = <0x01000000 0x0 0xf4100000 0x0 0xf4100000 0x0 0x00100000>,
	     <0x02000000 0x0 0xf4200000 0x0 0xf4200000 0x0 0x01e00000>;
};
